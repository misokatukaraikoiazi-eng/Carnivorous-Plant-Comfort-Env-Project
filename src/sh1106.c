#include "sh1106.h"
#include "driver/i2c.h"
#include "esp_log.h"
#include <stdio.h>
#include <string.h>

static const char *TAG = "SH1106";

#define I2C_PORT I2C_NUM_0
#define BUFFER_SIZE 1024 /* 128 x 64 bits = 8 pages x 128 bytes */

static uint8_t s_i2c_addr = SH1106_I2C_ADDR;
static uint8_t s_buffer[BUFFER_SIZE];

/* Standard 8x8 ASCII Font (32 to 126) */
static const uint8_t font8x8[95][8] = {
    {0x00, 0x00, 0x00, 0x00, 0x00, 0x00, 0x00, 0x00}, /*   */
    {0x00, 0x00, 0x5F, 0x00, 0x00, 0x00, 0x00, 0x00}, /* ! */
    {0x00, 0x07, 0x00, 0x07, 0x00, 0x00, 0x00, 0x00}, /* " */
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    {0x08, 0x04, 0x08, 0x10, 0x08, 0x00, 0x00, 0x00}  /* ~ */
};

static esp_err_t send_cmd(uint8_t cmd) {
    i2c_cmd_handle_t handle = i2c_cmd_link_create();
    i2c_master_start(handle);
    i2c_master_write_byte(handle, (s_i2c_addr << 1) | I2C_MASTER_WRITE, true);
    i2c_master_write_byte(handle, 0x00, true);
    i2c_master_write_byte(handle, cmd, true);
    i2c_master_stop(handle);
    esp_err_t ret = i2c_master_cmd_begin(I2C_PORT, handle, pdMS_TO_TICKS(100));
    i2c_cmd_link_delete(handle);
    return ret;
}

static esp_err_t send_data(const uint8_t *data, size_t len) {
    i2c_cmd_handle_t handle = i2c_cmd_link_create();
    i2c_master_start(handle);
    i2c_master_write_byte(handle, (s_i2c_addr << 1) | I2C_MASTER_WRITE, true);
    i2c_master_write_byte(handle, 0x40, true);
    i2c_master_write(handle, data, len, true);
    i2c_master_stop(handle);
    esp_err_t ret = i2c_master_cmd_begin(I2C_PORT, handle, pdMS_TO_TICKS(100));
    i2c_cmd_link_delete(handle);
    return ret;
}

bool sh1106_init(gpio_num_t sda_pin, gpio_num_t scl_pin, uint8_t i2c_addr) {
    s_i2c_addr = i2c_addr;

    i2c_config_t conf = {
        .mode = I2C_MODE_MASTER,
        .sda_io_num = sda_pin,
        .sda_pullup_en = GPIO_PULLUP_ENABLE,
        .scl_io_num = scl_pin,
        .scl_pullup_en = GPIO_PULLUP_ENABLE,
        .master.clk_speed = 400000,
        .clk_flags = 0
    };

    esp_err_t ret = i2c_param_config(I2C_PORT, &conf);
    if (ret != ESP_OK) {
        ESP_LOGE(TAG, "I2C param config failed: %s", esp_err_to_name(ret));
        return false;
    }

    ret = i2c_driver_install(I2C_PORT, conf.mode, 0, 0, 0);
    if (ret != ESP_OK && ret != ESP_ERR_INVALID_STATE) { /* ESP_ERR_INVALID_STATE if already installed */
        ESP_LOGE(TAG, "I2C driver install failed: %s", esp_err_to_name(ret));
        return false;
    }

    static const uint8_t init_cmds[] = {
        0xAE,       /* Display OFF */
        0x02,       /* Set low column address (offset 2 for SH1106) */
        0x10,       /* Set high column address */
        0x40,       /* Set start line address */
        0xB0,       /* Set page address */
        0x81, 0xCF, /* Set contrast control */
        0xA1,       /* Set Segment Re-map */
        0xA6,       /* Normal display */
        0xA8, 0x3F, /* Multiplex Ratio (1/64) */
        0xAD, 0x8B, /* Set Charge Pump / DC-DC enable */
        0xC8,       /* Set COM Output Scan Direction */
        0xD3, 0x00, /* Set Display Offset */
        0xD5, 0x80, /* Set Display Clock Divide Ratio */
        0xD9, 0x1F, /* Set Pre-charge Period */
        0xDA, 0x12, /* Set COM Pins Hardware Config */
        0xAF        /* Display ON */
    };

    for (size_t i = 0; i < sizeof(init_cmds); i++) {
        if (send_cmd(init_cmds[i]) != ESP_OK) {
            ESP_LOGE(TAG, "Failed to send SH1106 init command [0x%02X]", init_cmds[i]);
            return false;
        }
    }

    sh1106_clear();
    sh1106_update();
    ESP_LOGI(TAG, "SH1106 OLED initialized successfully at I2C address 0x%02X (SDA=%d, SCL=%d)",
             s_i2c_addr, sda_pin, scl_pin);
    return true;
}

void sh1106_clear(void) {
    memset(s_buffer, 0, sizeof(s_buffer));
}

void sh1106_draw_string(uint8_t row, uint8_t x, const char *str) {
    if (row >= 8 || x >= 128 || !str) return;

    while (*str && x < 128) {
        char c = *str;
        if (c < 32 || c > 126) c = ' ';
        uint8_t idx = c - 32;

        for (uint8_t col = 0; col < 8; col++) {
            if (x + col < 128) {
                s_buffer[row * 128 + (x + col)] = font8x8[idx][col];
            }
        }
        x += 8;
        str++;
    }
}

void sh1106_update(void) {
    for (uint8_t page = 0; page < 8; page++) {
        send_cmd(0xB0 | page); /* Set page */
        send_cmd(0x02);        /* Set lower column address offset = 2 */
        send_cmd(0x10);        /* Set higher column address offset = 0 */
        send_data(&s_buffer[page * 128], 128);
    }
}

void sh1106_display_sensor_data(const sensor_data_t *data, bool is_ac_mode) {
    char line_buf[20];

    sh1106_clear();

    /* Title Header (Row 0) */
    sh1106_draw_string(0, 0, "-- TERRARIUM --");

    /* Air Temp (Row 1) */
    snprintf(line_buf, sizeof(line_buf), "Temp : %.1f C", data->air_temp_c);
    sh1106_draw_string(1, 0, line_buf);

    /* Humidity (Row 2) */
    snprintf(line_buf, sizeof(line_buf), "Hum  : %.1f %%", data->humidity_percent);
    sh1106_draw_string(2, 0, line_buf);

    /* Water Temp (Row 3) */
    snprintf(line_buf, sizeof(line_buf), "Water: %.1f C", data->water_temp_c);
    sh1106_draw_string(3, 0, line_buf);

    /* Soil Dry Status (Row 4) */
    snprintf(line_buf, sizeof(line_buf), "Soil : %s", data->soil_dry ? "DRY (WARN)" : "OK");
    sh1106_draw_string(4, 0, line_buf);

    /* Fan Status (Row 5) */
    snprintf(line_buf, sizeof(line_buf), "Fan  : %s", data->fan_on ? "ON" : "OFF");
    sh1106_draw_string(5, 0, line_buf);

    /* Pump Status (Row 6) */
    snprintf(line_buf, sizeof(line_buf), "Pump : %s", data->pump_on ? "ON" : "OFF");
    sh1106_draw_string(6, 0, line_buf);

    /* Mode (Row 7) */
    snprintf(line_buf, sizeof(line_buf), "Mode : %s", is_ac_mode ? "AC-PWR" : "BATT");
    sh1106_draw_string(7, 0, line_buf);

    sh1106_update();
}
